## CMakeLists.txt
```
# SPDX-License-Identifier: Apache-2.0

cmake_minimum_required(VERSION 3.20.0)

find_package(Zephyr REQUIRED HINTS $ENV{ZEPHYR_BASE})
project(52prac3)
add_library(cjson STATIC mylib/cJSON.c)
target_sources(app PRIVATE src/main.c mylib/btscan52.c mylib/bt52.c)
target_include_directories(app PRIVATE include)
target_sources(app PRIVATE ${app_sources})

if(IBEACON_RSSI)
  zephyr_compile_definitions(IBEACON_RSSI=${IBEACON_RSSI})
endif()
```

## prj.conf
```kconfig
CONFIG_SERIAL=y
CONFIG_UART_INTERRUPT_DRIVEN=y
CONFIG_STDOUT_CONSOLE=y
CONFIG_I2C=y
CONFIG_SENSOR=y
CONFIG_CBPRINTF_FP_SUPPORT=y
CONFIG_BT=y
CONFIG_BT_OBSERVER=y
CONFIG_BT_BROADCASTER=y
CONFIG_LOG=y

CONFIG_USE_SEGGER_RTT=y
CONFIG_RTT_CONSOLE=y
CONFIG_UART_CONSOLE=n
```

## src/main.c
```c
/*
 *
 *    ┏┓　　　┏┓
 *  ┏┛┻━━━┛┻┓
 *  ┃　　　　　　　┃
 *  ┃　　　━　　　┃
 *  ┃　＞　　　＜　┃
 *  ┃　　　　　　　┃
 *  ┃...　⌒　...　┃
 *  ┃　　　　　　　┃
 *  ┗━┓　　　┏━┛
 *      ┃　　　┃　
 *      ┃　　　┃
 *      ┃　　　┃
 *      ┃　　　┃  神兽保佑
 *      ┃　　　┃  代码无bug　　
 *      ┃　　　┃
 *      ┃　　　┗━━━┓
 *      ┃　　　　　　　┣┓
 *      ┃　　　　　　　┏┛
 *      ┗┓┓┏━┳┓┏┛
 *        ┃┫┫　┃┫┫
 *        ┗┻┛　┗┻┛
 *
 *
 * @Author: s4627347 s4627347@student.uq.edu.au
 * @Date: 2024-03-12 09:50:17
 * @LastEditors: s4627347 s4627347@student.uq.edu.au
 * @LastEditTime: 2024-05-18 20:38:19
 * @FilePath: /csse4011/prac3/mycode/apps/final/thingy52/prac2/src/main.c
 * @Description: Main application entry point
 *
 * Copyright (c) 2024 by ${git_name_email}, All Rights Reserved.
 */

#include <stdio.h>
#include <zephyr/kernel.h>
#include <zephyr/drivers/gpio.h>
#include "btscan52.h"
#include "bt52.h"

#define LED0_NODE DT_ALIAS(led0)

/*
 * A build error on this line means your board is unsupported.
 * See the sample documentation for information on how to fix this.
 */
static const struct gpio_dt_spec led = GPIO_DT_SPEC_GET(LED0_NODE, gpios);

/**
 * @brief Function to execute the Bluetooth functionality in a thread.
 *
 * @return int Returns 0 on success.
 */
int bt_thread(void)
{
	bt();
	return 0;
}

void led_blink_thread(void)
{
	int ret;
	bool led_state = true;

	if (!gpio_is_ready_dt(&led))
	{
		return 0;
	}

	ret = gpio_pin_configure_dt(&led, GPIO_OUTPUT_ACTIVE);
	if (ret < 0)
	{
		return 0;
	}

	while (1)
	{
		ret = gpio_pin_toggle_dt(&led);
		if (ret < 0)
		{
			return 0;
		}
		led_state = !led_state;
		k_msleep(1000);
	}
}

K_THREAD_DEFINE(led_blink_id, STACKSIZE, led_blink_thread, NULL, NULL, NULL, PRIORITY, 0, 0);

K_THREAD_DEFINE(bt_id, STACKSIZE, bt_thread, NULL, NULL, NULL,
				PRIORITY, 0, 0);

// Main function
int main(void)
{
	//	k_thread_start(btscan_id);
	k_thread_start(bt_id);
	k_thread_start(led_blink_id);

	return 0;
}
```

## include/bt52.h
```c
/*
 * @Author: s4627347 s4627347@student.uq.edu.au
 * @Date: 2024-03-19 09:42:44
 * @LastEditors: s4627347 s4627347@student.uq.edu.au
 * @LastEditTime: 2024-05-18 20:01:16
 * @FilePath: /csse4011/prac3/mycode/apps/final/thingy52/prac2/include/bt52.h
 * @Description: Header file containing function declarations for Bluetooth operation.
 *
 * This header file declares the main function for Bluetooth operation, which initializes
 * Bluetooth and creates a thread to handle data reception.
 *
 * Copyright (c) 2024 by ${git_name_email}, All Rights Reserved.
 */

#ifndef BT52_H
#define BT52_H

#include <zephyr/types.h>
#include <stddef.h>
#include <zephyr/sys/printk.h>
#include <zephyr/sys/util.h>
#include <zephyr/kernel.h>
#include <zephyr/bluetooth/bluetooth.h>
#include <zephyr/bluetooth/hci.h>

#ifndef IBEACON_RSSI
#define IBEACON_RSSI 0xc8 /**< Default Calibrated RSSI @ 1m for iBeacon */
#define STACKSIZE 2048    /**< Default stack size for the Bluetooth thread */
#define PRIORITY 7        /**< Default priority for the Bluetooth thread */
#endif

/**
 * @brief Main function for Bluetooth operation.
 *
 * This function initializes Bluetooth and creates a thread to handle data reception.
 *
 * @return int Returns 0 on success.
 */
int bt(void);
void send_ble(uint8_t *basic);

#endif /* BT52_H */
```

## include/btscan52.h
```c
/*
 *                   ___====-_  _-====___
 *             _--^^^#####//      \\#####^^^--_
 *          _-^##########// (    ) \\##########^-_
 *         -############//  |\^^/|  \\############-
 *       _/############//   (@::@)   \############\_
 *      /#############((     \\//     ))#############\
 *     -###############\\    (oo)    //###############-
 *    -#################\\  / VV \  //#################-
 *   -###################\\/      \//###################-
 *  _#/|##########/\######(   /\   )######/\##########|\#_
 *  |/ |#/\#/\#/\/  \#/\##\  |  |  /##/\#/  \/\#/\#/\#| \|
 *  `  |/  V  V  `   V  \#\| |  | |/#/  V   '  V  V  \|  '
 *     `   `  `      `   / | |  | | \   '      '  '   '
 *                      (  | |  | |  )
 *                     __\ | |  | | /__
 *                    (vvv(VVV)(VVV)vvv)
 *
 *      ~~~~~~~~~~~~~~~~~~~~~~~~~~~~~~~~~~~~~~~~~~~
 *
 *                神兽保佑            永无BUG
 *
 * @Author: s4627347 s4627347@student.uq.edu.au
 * @Date: 2024-03-19 11:00:12
 * @LastEditors: s4627347 s4627347@student.uq.edu.au
 * @LastEditTime: 2024-04-12 11:06:10
 * @FilePath: /csse4011/prac3/mycode/apps/thingy52/prac2/include/btscan52.h
 * @Description:
 *
 * Copyright (c) 2024 by ${git_name_email}, All Rights Reserved.
 */

#include <zephyr/sys/printk.h>
#include <zephyr/bluetooth/bluetooth.h>
#include <zephyr/bluetooth/hci.h>
#include <zephyr/bluetooth/addr.h>
#include "bt52.h"

#define NAME_LEN 30
#define UUID_LENGTH 16
#define UUID_OFFSET 6

#define BEACON_A "F5:75:FE:85:34:67 (random)"
#define BEACON_B "E5:73:87:06:1E:86 (random)"
#define BEACON_C "CA:99:9E:FD:98:B1 (random)"
#define BEACON_D "CB:1B:89:82:FF:FE (random)"
#define BEACON_E "D4:D2:A0:A4:5C:AC (random)"
#define BEACON_F "C1:13:27:E9:B7:7C (random)"
#define BEACON_G "F1:04:48:06:39:A0 (random)"
#define BEACON_H "CA:0C:E0:DB:CE:60 (random)"
#define BEACON_I "D4:7F:D4:7C:20:13 (random)"
#define BEACON_J "F7:0B:21:F1:C8:E1 (random)"
#define BEACON_K "FD:E0:8D:FA:3E:4A (random)"
#define BEACON_L "EE:32:F7:28:FA:AC (random)"

/**
 * @brief Start Bluetooth scanning.
 *
 * This function starts Bluetooth scanning to discover nearby devices.
 *
 * @return int Returns 0 on success, or an error code otherwise.
 */
int btscan(void);

/**
 * @brief Get the temperature value.
 *
 * This function returns the temperature value obtained from Bluetooth scanning.
 *
 * @return uint8_t The temperature value.
 */
int8_t get_rssi_beacon(uint8_t beacon_id);
void observer_start(void);
```
